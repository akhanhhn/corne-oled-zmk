## config/west.yml
```yaml
manifest:
  remotes:
    - name: zmkfirmware
      url-base: https://github.com/zmkfirmware
    # Additional modules containing boards/shields/custom code can be listed here as well
    # See https://docs.zephyrproject.org/3.2.0/develop/west/manifest.html#projects
  projects:
    - name: zmk
      remote: zmkfirmware
      #revision: main
      revision: 3b7e8894a56e2f1ebf4a28c68bddcba7f7e0e3a0
      import: app/west.yml
  self:
    path: config
```
